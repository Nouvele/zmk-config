## boards/shields/nouvebt/Kconfig.shield
```kconfig
config SHIELD_NOUVEBT_LEFT
    def_bool $(shields_list_contains,nouvebt_left)

config SHIELD_NOUVEBT_RIGHT
    def_bool $(shields_list_contains,nouvebt_right)
```

## config/Kconfig.defconfig
```kconfig
if SHIELD_NOUVEBT_LEFT

config ZMK_KEYBOARD_NAME
    default "NouveBT"

config ZMK_SPLIT_ROLE_CENTRAL
    default y

endif

if SHIELD_NOUVEBT_LEFT || SHIELD_NOUVEBT_RIGHT

config ZMK_SPLIT
    default y

endif
```
