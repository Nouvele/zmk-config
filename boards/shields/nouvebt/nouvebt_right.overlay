#include "nouvebt_left.overlay"

&default_transform {
    col-offset = <6>;
};

&kscan0 {
    row-gpios
        = <&gpio1 11 (GPIO_ACTIVE_LOW | GPIO_PULL_UP)> 
        , <&gpio0 29 (GPIO_ACTIVE_LOW | GPIO_PULL_UP)> 
        , <&gpio0 2  (GPIO_ACTIVE_LOW | GPIO_PULL_UP)> 
        , <&gpio1 15 (GPIO_ACTIVE_LOW | GPIO_PULL_UP)> 
        , <&gpio1 13 (GPIO_ACTIVE_LOW | GPIO_PULL_UP)> 
        ;

    col-gpios
        = <&gpio0 20 GPIO_ACTIVE_LOW> 
        , <&gpio0 22 GPIO_ACTIVE_LOW> 
        , <&gpio0 24 GPIO_ACTIVE_LOW> 
        , <&gpio1 0  GPIO_ACTIVE_LOW> 
        , <&gpio0 11 GPIO_ACTIVE_LOW> 
        , <&gpio1 4  GPIO_ACTIVE_LOW> 
        ;
};